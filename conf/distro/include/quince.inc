## conf/distro/include/quince.inc
```bitbake
#
# Quince Distribution - Variables Definition
#

# Specifies the formats the OpenEmbedded build system uses during the build when creating the root filesystem
IMAGE_FSTYPES += "ext4"

# Specifies the package manager the OpenEmbedded build system uses when packaging data
PACKAGE_CLASSES ?= "package_ipk"

# Defines the root home directory
ROOT_HOME ?= "/root"

# Specifies the name of the target vendor
TARGET_VENDOR = "-quince"

# (until Yocto 5.0) Specifies a suffix to be appended onto the TMPDIR value
TCLIBCAPPEND = ""

# Specifies the toolchain selector
TCMODE ?= "default"


# Specifies the name of the SDK vendor
SDK_VENDOR = "-quince"

# Specifies the version of the SDK
SDK_VERSION = "${DISTRO_VERSION}"

# The base name for SDK output files
SDK_NAME = "sdk-${IMAGE_BASENAME}-${MACHINE}-${SDK_VERSION}"

# Defines the path offered to the user for installation of the SDK that is generated by the OpenEmbedded build system
SDKPATHINSTALL = "${HOME}/${SDK_NAME}"


# Enable creation of SPDX manifests by default
INHERIT += "create-spdx"

# Make the SPDX output more human-readable, using identation and newlines
SPDX_PRETTY = "1"

# Add a description of the source files used to build the host tools and the target packages, to the spdx.json files
#SPDX_INCLUDE_SOURCES = "1"

# Add to SPDX output compressed archives of the sources for packages installed on the target
#SPDX_ARCHIVE_SOURCES = "1"

# Add to SPDX output compressed archives of the files in the generated target packages
#SPDX_ARCHIVE_PACKAGED = "1"
```

## conf/distro/quince-systemd.conf
```bitbake
#
# Quince Distribution (systemd version) Configuration
#

# The long name of the distribution
DISTRO_NAME = "quince-systemd"

# The version of the distribution
DISTRO_VERSION = "5.0.8"

# Specifies a codename for the distribution being built
DISTRO_CODENAME = "scarthgap"

# The email address of the distribution maintainer
MAINTAINER = "Sugiura Ryusuke <https://github.com/sugiura-ryusuke>"


require conf/distro/include/quince.inc

# The software support you want in your distribution for various features
QUINCE_DISTRO_FEATURES ?= "ldconfig multiarch"
DISTRO_FEATURES ?= "${DISTRO_FEATURES_DEFAULT} ${QUINCE_DISTRO_FEATURES}"

# Specifies a list of distro-specific packages to add to all images
DISTRO_EXTRA_RDEPENDS += ""

# Specifies a list of distro-specific packages to add to all images if the packages exist
DISTRO_EXTRA_RRECOMMENDS += ""

# Specifies the GNU standard C library (libc) variant to use during the build process
TCLIBC ?= "glibc"


# Specifies the system init manager to use
INIT_MANAGER = "systemd"
DISTRO_FEATURES_BACKFILL_CONSIDERED:append = " sysvinit"
VIRTUAL-RUNTIME_dev_manager = "systemd"
VIRTUAL-RUNTIME_init_manager = "systemd"
VIRTUAL-RUNTIME_initscripts = "systemd-compat-units"
VIRTUAL-RUNTIME_keymaps = "keymaps"
VIRTUAL-RUNTIME_login_manager = "shadow-base"
VIRTUAL-RUNTIME_syslog = "syslog-ng"


# Disable automatically mount storage devices
QUINCE_DISABLE_AUTOMOUNT_STORAGE ?= "0"

# Disable LAN connection at startup
QUINCE_DISABLE_LAN_STARTUP ?= "0"

# eth0 IP address
#QUINCE_ETH0_ADDRESS ?= "192.168.1.100"

# eth0 subnet mask (only valid if QUINCE_ETH0_ADDRESS is defined)
#QUINCE_ETH0_NETMASK ?= "255.255.255.0"

# eth0 default gateway (only valid if QUINCE_ETH0_ADDRESS is defined)
#QUINCE_ETH0_GATEWAY ?= "192.168.1.1"

# use PHRAM (for Booting Linux Kernel with rootfs in PHRAM)
QUINCE_PHRAM ?= "1"

# rootfs image file name
QUINCE_ROOTFS_IMG_FILE ?= "rootfs.img"

# opt image file name
QUINCE_OPT_IMG_FILE ?= "opt.img"


include conf/distro/machine/${MACHINE}.conf
```

## conf/distro/quince.conf
```bitbake
#
# Quince Distribution (busybox version) Configuration
#

# The long name of the distribution
DISTRO_NAME = "quince"

# The version of the distribution
DISTRO_VERSION = "5.0.8"

# Specifies a codename for the distribution being built
DISTRO_CODENAME = "scarthgap"

# The email address of the distribution maintainer
MAINTAINER = "Sugiura Ryusuke <https://github.com/sugiura-ryusuke>"


require conf/distro/include/quince.inc

# The software support you want in your distribution for various features
QUINCE_DISTRO_FEATURES ?= "ldconfig multiarch"
DISTRO_FEATURES ?= "${DISTRO_FEATURES_DEFAULT} ${QUINCE_DISTRO_FEATURES}"

# Specifies a list of distro-specific packages to add to all images
DISTRO_EXTRA_RDEPENDS += ""

# Specifies a list of distro-specific packages to add to all images if the packages exist
DISTRO_EXTRA_RRECOMMENDS += ""

# Specifies the GNU standard C library (libc) variant to use during the build process
TCLIBC ?= "glibc"


# Specifies the system init manager to use
INIT_MANAGER = "mdev-busybox"
DISTRO_FEATURES_BACKFILL_CONSIDERED:append = " systemd sysvinit"
VIRTUAL-RUNTIME_dev_manager = "busybox-mdev"
VIRTUAL-RUNTIME_init_manager = "busybox"
VIRTUAL-RUNTIME_initscripts = "initscripts"
VIRTUAL-RUNTIME_keymaps = "keymaps"
VIRTUAL-RUNTIME_login_manager = "busybox"
VIRTUAL-RUNTIME_syslog = "busybox-syslog"


# Package names in the /opt directory (This system calls /opt/${QUINCE_OPT_PACKAGE_NAME}/etc/rc.local at startup)
QUINCE_OPT_PACKAGE_NAME ?= "quince"

# Disable LAN connection at startup
QUINCE_DISABLE_LAN_STARTUP ?= "0"

# eth0 IP address
#QUINCE_ETH0_ADDRESS ?= "192.168.1.100"

# eth0 subnet mask (only valid if QUINCE_ETH0_ADDRESS is defined)
#QUINCE_ETH0_NETMASK ?= "255.255.255.0"

# eth0 default gateway (only valid if QUINCE_ETH0_ADDRESS is defined)
#QUINCE_ETH0_GATEWAY ?= "192.168.1.1"

# use PHRAM (for Booting Linux Kernel with rootfs in PHRAM)
QUINCE_PHRAM ?= "1"

# rootfs image file name
QUINCE_ROOTFS_IMG_FILE ?= "rootfs.img"

# opt image file name
QUINCE_OPT_IMG_FILE ?= "opt.img"


include conf/distro/machine/${MACHINE}.conf
```

## conf/layer.conf
```bitbake
# We have a conf and classes directory, append to BBPATH
BBPATH .= ":${LAYERDIR}"

# We have a recipes directory containing .bb and .bbappend files, add to BBFILES
BBFILES += "${LAYERDIR}/recipes*/*/*.bb \
            ${LAYERDIR}/recipes*/*/*.bbappend"

BBFILE_COLLECTIONS += "quince"
BBFILE_PATTERN_quince = "^${LAYERDIR}/"
BBFILE_PRIORITY_quince = "15"

LAYERDEPENDS_quince = "core"
LAYERSERIES_COMPAT_quince = "scarthgap"

DISTRO ?= "quince"
```
